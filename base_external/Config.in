## base_external/Config.in
```kconfig
source "$BR2_EXTERNAL_project_base_PATH/package/lcd-test/Config.in"
source "$BR2_EXTERNAL_project_base_PATH/package/clientsocket/Config.in"
source "$BR2_EXTERNAL_project_base_PATH/package/server/Config.in"
```

## base_external/package/clientsocket/Config.in
```kconfig
config BR2_PACKAGE_CLIENTSOCKET
	bool "clientsocket"
	help
	  to test socket comm in client on rpi
```

## base_external/package/lcd-test/Config.in
```kconfig
config BR2_PACKAGE_LCD_TEST
	bool "lcd-test"
	help
	  to test lcd application on rpi
```

## base_external/package/server/Config.in
```kconfig
config BR2_PACKAGE_SERVER
	bool "server"
	help
	  to test socket comm in server on rpi
```
